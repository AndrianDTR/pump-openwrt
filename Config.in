## Config.in
```kconfig
# Copyright (C) 2006-2012 OpenWrt.org
#
# This is free software, licensed under the GNU General Public License v2.
# See /LICENSE for more information.
#

config PACKAGE_PUMP
	bool "Pump build Options"
	default y
	help
	  Pump build opts help
	  
```
